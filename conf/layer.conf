## conf/layer.conf
```bitbake
# We have a conf and classes directory, add to BBPATH
BBPATH .= ":${LAYERDIR}"

# We have a packages directory, add to BBFILES
BBFILES += "${LAYERDIR}/recipes-*/*/*.bb \
            ${LAYERDIR}/recipes-*/*/*.bbappend"

#BBFILE_COLLECTIONS += "advantech-arm-extra"
#BBFILE_COLLECTIONS += "fsl-bsp-release"
BBFILE_PATTERN_BA16-GEChina-extra := "^${LAYERDIR}/"
BBFILE_PRIORITY_BA16-GEChina-extra = "8"

LAYERDEPENDS_advantech-arm-extra = "core fsl-arm fsl-arm-extra"
```
